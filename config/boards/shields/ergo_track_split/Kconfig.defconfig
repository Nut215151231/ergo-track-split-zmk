## config/boards/shields/ergo_track_split/Kconfig.defconfig
```kconfig
if SHIELD_ERGO_TRACK_SPLIT_LEFT

config ZMK_KEYBOARD_NAME
    default "Ergo Track Split"

config ZMK_SPLIT_ROLE_CENTRAL
    default y

endif

if SHIELD_ERGO_TRACK_SPLIT_RIGHT

config ZMK_KEYBOARD_NAME
    default "Ergo Track Split"

# Enable PMW3610 trackball driver for right side
config PMW3610
    default y
    select SPI
    select INPUT

endif

if SHIELD_ERGO_TRACK_SPLIT_LEFT || SHIELD_ERGO_TRACK_SPLIT_RIGHT

config ZMK_SPLIT
    default y

endif
```

## config/boards/shields/ergo_track_split/Kconfig.shield
```kconfig
# Copyright (c) 2024
# SPDX-License-Identifier: MIT

config SHIELD_ERGO_TRACK_SPLIT_LEFT
	def_bool $(shields_list_contains,ergo_track_split_left)

config SHIELD_ERGO_TRACK_SPLIT_RIGHT
	def_bool $(shields_list_contains,ergo_track_split_right)

# Enable PMW3610 driver when right shield is selected
if SHIELD_ERGO_TRACK_SPLIT_RIGHT

config PMW3610
	default y

config SPI
	default y

endif # SHIELD_ERGO_TRACK_SPLIT_RIGHT

# Enable PMW3610 driver when right shield is selected
if SHIELD_ERGO_TRACK_SPLIT_RIGHT

config PMW3610
	default y

config SPI
	default y

endif # SHIELD_ERGO_TRACK_SPLIT_RIGHT
```

## config/west.yml
```yaml
manifest:
  remotes:
    - name: zmkfirmware
      url-base: https://github.com/zmkfirmware
    - name: dxue
      url-base: https://github.com/dxue
  projects:
    - name: zmk
      remote: zmkfirmware
      revision: main
      import: app/west.yml
    - name: zmk-auto-layer
      remote: dxue
      # ブランチ名ではなく、特定のコミットを指定して安定させます
      revision: d32766f65839b66c40689e472251a37c093a129f 
```
